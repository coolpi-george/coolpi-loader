## arch/arm/mach-rockchip/rk3506/Kconfig
```kconfig
if ROCKCHIP_RK3506

config TARGET_EVB_RK3506
	bool "EVB_RK3506"
	select BOARD_LATE_INIT
	help
	  RK3506 EVB is a evaluation board for Rockchip RK3506.
	  
config TARGET_COOLPI_RK3506B_CP2B
	bool "COOLPI_RK3506B_CP2B"
	select BOARD_LATE_INIT
	help
	  COOLPI_RK3506B_CP2B is a evaluation board for Rockchip RK3506B.

config TARGET_COOLPI_RK3506_CP2BP
	bool "COOLPI_RK3506_CP2BP"
	select BOARD_LATE_INIT
	help
	  COOLPI_RK3506_CP2BP is a evaluation board for Rockchip RK3506B.

config SYS_SOC
	default "rockchip"

config SYS_MALLOC_F_LEN
	default 0x400

source board/rockchip/evb_rk3506/Kconfig
source board/rockchip/coolpi_rk3506b_cp2b/Kconfig
source board/rockchip/coolpi_rk3506_cp2bp/Kconfig

endif
```

## arch/arm/mach-rockchip/rk3568/Kconfig
```kconfig
if ROCKCHIP_RK3568

config TARGET_EVB_RK3568
	bool "EVB_RK3568"
	select BOARD_LATE_INIT
	help
	  RK3568 EVB is a evaluation board for Rockchp RK3568.
	  
config TARGET_COOLPI_RK3566_CP3B1
	bool "COOLPI_RK3566_CP3B1"
	select BOARD_LATE_INIT
	help
	  COOLPI_RK3566_CP3B1 is a evaluation board for Rockchp RK3566.
	  
config TARGET_COOLPI_RK3566_CP3ZX
	bool "COOLPI_RK3566_CP3ZX"
	select BOARD_LATE_INIT
	help
	  COOLPI_RK3566_CP3ZX is a evaluation board for Rockchp RK3566.
	  
config TARGET_COOLPI_RK3566_CP3H8
	bool "COOLPI_RK3566_CP3H8"
	select BOARD_LATE_INIT
	help
	  COOLPI_RK3566_CP3H8 is a evaluation board for Rockchp RK3566.
	  
config TARGET_COOLPI_RK3566_HMI10
	bool "COOLPI_RK3566_HMI10"
	select BOARD_LATE_INIT
	help
	  COOLPI_RK3566_HMI10 is a evaluation board for Rockchp RK3566.
	  
config TARGET_COOLPI_RK3566_HMI11
	bool "COOLPI_RK3566_HMI11"
	select BOARD_LATE_INIT
	help
	  COOLPI_RK3566_HMI11 is a evaluation board for Rockchp RK3566.
	  
config TARGET_COOLPI_RK3566_PLCV1
	bool "COOLPI_RK3566_PLCV1"
	select BOARD_LATE_INIT
	help
	  COOLPI_RK3566_PLCV1 is a evaluation board for Rockchp RK3566.
	  
config TARGET_COOLPI_RK3566_AIBOX
	bool "COOLPI_RK3566_AIBOX"
	select BOARD_LATE_INIT
	help
	  COOLPI_RK3566_AIBOX is a evaluation board for Rockchp RK3566.

config SYS_SOC
	default "rockchip"

config SYS_MALLOC_F_LEN
	default 0x400

source board/rockchip/evb_rk3568/Kconfig
source board/rockchip/coolpi_rk3566_cp3b1/Kconfig
source board/rockchip/coolpi_rk3566_cp3zx/Kconfig
source board/rockchip/coolpi_rk3566_cp3h8/Kconfig
source board/rockchip/coolpi_rk3566_hmi10/Kconfig
source board/rockchip/coolpi_rk3566_plcv1/Kconfig
source board/rockchip/coolpi_rk3566_hmi11/Kconfig
source board/rockchip/coolpi_rk3566_aibox/Kconfig

endif
```

## board/rockchip/coolpi_rk3506_cp2bp/Kconfig
```kconfig
if TARGET_COOLPI_RK3506_CP2BP

config SYS_BOARD
	default "coolpi_rk3506_cp2bp"

config SYS_VENDOR
	default "rockchip"

config SYS_CONFIG_NAME
	default "coolpi_rk3506_cp2bp"

config BOARD_SPECIFIC_OPTIONS # dummy
	def_bool y

endif
```

## board/rockchip/coolpi_rk3506b_cp2b/Kconfig
```kconfig
if TARGET_COOLPI_RK3506B_CP2B

config SYS_BOARD
	default "coolpi_rk3506b_cp2b"

config SYS_VENDOR
	default "rockchip"

config SYS_CONFIG_NAME
	default "coolpi_rk3506b_cp2b"

config BOARD_SPECIFIC_OPTIONS # dummy
	def_bool y

endif
```

## board/rockchip/coolpi_rk3566_aibox/Kconfig
```kconfig
if TARGET_COOLPI_RK3566_AIBOX

config SYS_BOARD
	default "coolpi_rk3566_aibox"

config SYS_VENDOR
	default "rockchip"

config SYS_CONFIG_NAME
	default "coolpi_rk3566_aibox"

config BOARD_SPECIFIC_OPTIONS # dummy
	def_bool y

endif
```

## board/rockchip/coolpi_rk3566_cp3b1/Kconfig
```kconfig
if TARGET_COOLPI_RK3566_CP3B1

config SYS_BOARD
	default "coolpi_rk3566_cp3b1"

config SYS_VENDOR
	default "rockchip"

config SYS_CONFIG_NAME
	default "coolpi_rk3566_cp3b1"

config BOARD_SPECIFIC_OPTIONS # dummy
	def_bool y

endif
```

## board/rockchip/coolpi_rk3566_cp3h8/Kconfig
```kconfig
if TARGET_COOLPI_RK3566_CP3H8

config SYS_BOARD
	default "coolpi_rk3566_cp3h8"

config SYS_VENDOR
	default "rockchip"

config SYS_CONFIG_NAME
	default "coolpi_rk3566_cp3h8"

config BOARD_SPECIFIC_OPTIONS # dummy
	def_bool y

endif
```

## board/rockchip/coolpi_rk3566_cp3zx/Kconfig
```kconfig
if TARGET_COOLPI_RK3566_CP3ZX

config SYS_BOARD
	default "coolpi_rk3566_cp3zx"

config SYS_VENDOR
	default "rockchip"

config SYS_CONFIG_NAME
	default "coolpi_rk3566_cp3zx"

config BOARD_SPECIFIC_OPTIONS # dummy
	def_bool y

endif
```

## board/rockchip/coolpi_rk3566_hmi10/Kconfig
```kconfig
if TARGET_COOLPI_RK3566_HMI10

config SYS_BOARD
	default "coolpi_rk3566_hmi10"

config SYS_VENDOR
	default "rockchip"

config SYS_CONFIG_NAME
	default "coolpi_rk3566_hmi10"

config BOARD_SPECIFIC_OPTIONS # dummy
	def_bool y

endif
```

## board/rockchip/coolpi_rk3566_hmi11/Kconfig
```kconfig
if TARGET_COOLPI_RK3566_HMI11

config SYS_BOARD
	default "coolpi_rk3566_hmi11"

config SYS_VENDOR
	default "rockchip"

config SYS_CONFIG_NAME
	default "coolpi_rk3566_hmi11"

config BOARD_SPECIFIC_OPTIONS # dummy
	def_bool y

endif
```

## board/rockchip/coolpi_rk3566_plcv1/Kconfig
```kconfig
if TARGET_COOLPI_RK3566_PLCV1

config SYS_BOARD
	default "coolpi_rk3566_plcv1"

config SYS_VENDOR
	default "rockchip"

config SYS_CONFIG_NAME
	default "coolpi_rk3566_plcv1"

config BOARD_SPECIFIC_OPTIONS # dummy
	def_bool y

endif
```

## board/rockchip/coolpi_rk3588_aibox/Kconfig
```kconfig
if TARGET_COOLPI_RK3588_AIBOX

config SYS_BOARD
	default "coolpi_rk3588_aibox"

config SYS_VENDOR
	default "rockchip"

config SYS_CONFIG_NAME
	default "coolpi_rk3588_aibox"

config BOARD_SPECIFIC_OPTIONS # dummy
	def_bool y

endif
```

## board/rockchip/coolpi_rk3588_chn60/Kconfig
```kconfig
if TARGET_COOLPI_RK3588_CHN60

config SYS_BOARD
	default "coolpi_rk3588_chn60"

config SYS_VENDOR
	default "rockchip"

config SYS_CONFIG_NAME
	default "coolpi_rk3588_chn60"

config BOARD_SPECIFIC_OPTIONS # dummy
	def_bool y

endif
```

## board/rockchip/coolpi_rk3588_cm5ss/Kconfig
```kconfig
if TARGET_COOLPI_RK3588_CM5SS

config SYS_BOARD
	default "coolpi_rk3588_cm5ss"

config SYS_VENDOR
	default "rockchip"

config SYS_CONFIG_NAME
	default "coolpi_rk3588_cm5ss"

config BOARD_SPECIFIC_OPTIONS # dummy
	def_bool y

endif
```

## board/rockchip/coolpi_rk3588_hmi11/Kconfig
```kconfig
if TARGET_COOLPI_RK3588_HMI11

config SYS_BOARD
	default "coolpi_rk3588_hmi11"

config SYS_VENDOR
	default "rockchip"

config SYS_CONFIG_NAME
	default "coolpi_rk3588_hmi11"

config BOARD_SPECIFIC_OPTIONS # dummy
	def_bool y

endif
```
