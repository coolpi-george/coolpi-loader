## arch/arm/mach-rockchip/rk3588/Kconfig
```kconfig
if ROCKCHIP_RK3588

config TARGET_EVB_RK3588
	bool "EVB_RK3588"
	select BOARD_LATE_INIT
	help
	  RK3588 EVB is a evaluation board for Rockchp RK3588.

config TARGET_COOLPI_RK3588S_CP4B
	bool "COOLPI_RK3588S_CP4B"
	select BOARD_LATE_INIT
	help
	  COOLPI_RK3588S_CP4B is a evaluation board for Rockchp RK3588S.
	
config TARGET_COOLPI_RK3588_CM5V1
	bool "COOLPI_RK3588 CM5"
	select BOARD_LATE_INIT
	help
	  COOLPI_RK3588_CM5 is a evaluation board for Rockchp RK3588.

config SYS_SOC
	default "rockchip"

config SYS_MALLOC_F_LEN
	default 0x400

source board/rockchip/evb_rk3588/Kconfig
source board/rockchip/coolpi_rk3588s_cp4b/Kconfig
source board/rockchip/coolpi_rk3588_cm5v1/Kconfig

endif
```

## board/rockchip/coolpi_rk3566/Kconfig
```kconfig
if TARGET_COOLPI_RK3566

config SYS_BOARD
	default "coolpi_rk3566"

config SYS_VENDOR
	default "rockchip"

config SYS_CONFIG_NAME
	default "coolpi_rk3566"

config BOARD_SPECIFIC_OPTIONS # dummy
	def_bool y

endif
```

## board/rockchip/coolpi_rk3588_cm5lz/Kconfig
```kconfig
if TARGET_COOLPI_RK3588_CM5LZ

config SYS_BOARD
	default "coolpi_rk3588_cm5lz"

config SYS_VENDOR
	default "rockchip"

config SYS_CONFIG_NAME
	default "coolpi_rk3588_cm5lz"

config BOARD_SPECIFIC_OPTIONS # dummy
	def_bool y

endif
```

## board/rockchip/coolpi_rk3588_cm5ts/Kconfig
```kconfig
if TARGET_COOLPI_RK3588_CM5TS

config SYS_BOARD
	default "coolpi_rk3588_cm5ts"

config SYS_VENDOR
	default "rockchip"

config SYS_CONFIG_NAME
	default "coolpi_rk3588_cm5ts"

config BOARD_SPECIFIC_OPTIONS # dummy
	def_bool y

endif
```

## board/rockchip/coolpi_rk3588_gbook/Kconfig
```kconfig
if TARGET_COOLPI_RK3588_GBOOK

config SYS_BOARD
	default "coolpi_rk3588_gbook"

config SYS_VENDOR
	default "rockchip"

config SYS_CONFIG_NAME
	default "coolpi_rk3588_gbook"

config BOARD_SPECIFIC_OPTIONS # dummy
	def_bool y

endif
```

## board/rockchip/coolpi_rk3588s_cp4b/Kconfig
```kconfig
if TARGET_COOLPI_RK3588S_CP4B

config SYS_BOARD
	default "coolpi_rk3588s_cp4b"

config SYS_VENDOR
	default "rockchip"

config SYS_CONFIG_NAME
	default "coolpi_rk3588s_cp4b"

config BOARD_SPECIFIC_OPTIONS # dummy
	def_bool y

endif
```

## board/rockchip/coolpi_rk3588s_khos/Kconfig
```kconfig
if TARGET_COOLPI_RK3588S_KHOS

config SYS_BOARD
	default "coolpi_rk3588s_khos"

config SYS_VENDOR
	default "rockchip"

config SYS_CONFIG_NAME
	default "coolpi_rk3588s_khos"

config BOARD_SPECIFIC_OPTIONS # dummy
	def_bool y

endif
```

## board/rockchip/coolpi_rv1106_emmc/Kconfig
```kconfig
if TARGET_COOLPI_RV1106_EMMC

config SYS_BOARD
	default "coolpi_rv1106_emmc"

config SYS_VENDOR
	default "rockchip"

config SYS_CONFIG_NAME
	default "coolpi_rv1106_emmc"

config BOARD_SPECIFIC_OPTIONS # dummy
	def_bool y

endif
```
